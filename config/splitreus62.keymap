// Copyright 2021 Manna Harbour
// https://github.com/manna-harbour/miryoku

#include "../miryoku/custom_config.h"
#include "../miryoku/mapping/62/atreus.h"
#include "../miryoku/miryoku.dtsi"

/ {
};
