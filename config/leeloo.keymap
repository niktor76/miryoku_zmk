// Copyright 2022 Manna Harbour
// https://github.com/manna-harbour/miryoku

#include "../miryoku/custom_config.h"
#include "../miryoku/mapping/58/leeloo.h"
#include "../miryoku/miryoku.dtsi"

/ {
};
