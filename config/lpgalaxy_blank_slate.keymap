// Copyright 2024 Manna Harbour
// https://github.com/manna-harbour/miryoku

#include "../miryoku/custom_config.h"
#include "../miryoku/mapping/48/planck.h"
#include "../miryoku/miryoku.dtsi"

/ {
};
