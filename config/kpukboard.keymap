// Copyright 2023 Manna Harbour
// https://github.com/manna-harbour/miryoku

#include "../miryoku/custom_config.h"
#include "../miryoku/mapping/38/kpukboard.h"
#include "../miryoku/miryoku.dtsi"

/ {
};
