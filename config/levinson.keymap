// Copyright 2021 Manna Harbour
// https://github.com/manna-harbour/miryoku

#include "../miryoku/custom_config.h"
#include "../miryoku/mapping/48/lets_split.h"
#include "../miryoku/miryoku.dtsi"

/ {
};
