// Copyright 2021 Manna Harbour
// https://github.com/manna-harbour/miryoku

#include "../miryoku/custom_config.h"
#include "../miryoku/mapping/39/reviung39.h"
#include "../miryoku/miryoku.dtsi"

/ {
};
