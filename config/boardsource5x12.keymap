// Copyright 2021 Manna Harbour
// https://github.com/manna-harbour/miryoku

#include "../miryoku/custom_config.h"
#include "../miryoku/mapping/60/preonic.h"
#include "../miryoku/miryoku.dtsi"

/ {
};
