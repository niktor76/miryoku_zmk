// Copyright 2022 Manna Harbour
// https://github.com/manna-harbour/miryoku

#include "../miryoku/custom_config.h"
#include "../miryoku/mapping/48/hillside48.h"
#include "../miryoku/miryoku.dtsi"

/ {
};
