// Copyright 2022 Manna Harbour
// https://github.com/manna-harbour/miryoku

#include "../miryoku/custom_config.h"
#include "../miryoku/mapping/61/60_ansi.h"
#include "../miryoku/miryoku.dtsi"

/ {
};
