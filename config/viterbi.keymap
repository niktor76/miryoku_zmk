// Copyright 2021 Manna Harbour
// https://github.com/manna-harbour/miryoku

#include "../miryoku/custom_config.h"
#include "../miryoku/mapping/70/viterbi.h"
#include "../miryoku/miryoku.dtsi"

/ {
};
